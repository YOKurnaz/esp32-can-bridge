## sdkconfig.defaults
```kconfig
CONFIG_IDF_TARGET="esp32"
CONFIG_ESPTOOLPY_FLASHSIZE_4MB=y
CONFIG_PARTITION_TABLE_SINGLE_APP=y
CONFIG_LOG_DEFAULT_LEVEL_WARN=y


CONFIG_BT_ENABLED=y
CONFIG_BT_CLASSIC_ENABLED=y
CONFIG_BT_SPP_ENABLED=y

# Bluetooth Dual Mode (BLE + Classic)
CONFIG_BTDM_CTRL_MODE_BTDM=y
CONFIG_BTDM_CONTROLLER_MODE_BTDM=y
```
